## nemu/src/memory/Kconfig
```kconfig
menu "Memory Configuration"

config MBASE
  hex "Memory base address"
  default 0x0        if ISA_x86
  default 0x80000000

config MSIZE
  hex "Memory size"
  default 0x8000000

config PC_RESET_OFFSET
  hex "Offset of reset vector from the base of memory"
  default 0x100000 if ISA_x86
  default 0

choice
  prompt "Physical memory definition"
  default PMEM_GARRAY
config PMEM_MALLOC
  bool "Using malloc()"
config PMEM_GARRAY
  depends on !TARGET_AM
  bool "Using global array"
endchoice

config MEM_RANDOM
  depends on MODE_SYSTEM && !DIFFTEST && !TARGET_AM
  bool "Initialize the memory with random values"
  default y
  help
    This may help to find undefined behaviors.

config MTRACE
    bool "Enable Memory Trace"
    default y
    help
      Enable memory trace to record memory access.

config MTRACE_START
    hex "Start address of memory trace"
    default 0x80000000
    depends on MTRACE
    help
      The start address of the memory range to trace.

config MTRACE_END
    hex "End address of memory trace"
    default 0x88000000
    depends on MTRACE
    help
      The end address of the memory range to trace.


endmenu #MEMORY
```
